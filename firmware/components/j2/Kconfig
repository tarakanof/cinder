## firmware/components/j2/Kconfig
```kconfig
menu "J2 header: room sensors and speaker"

    config CINDER_J2_I2C_SDA
        int "I2C SDA GPIO (-1: no sensor bus)"
        range -1 48
        default 44

    config CINDER_J2_I2C_SCL
        int "I2C SCL GPIO"
        range -1 48
        default 43

    config CINDER_J2_I2S_BCLK
        int "MAX98357A BCLK GPIO (-1: no speaker)"
        range -1 48
        default -1

    config CINDER_J2_I2S_LRC
        int "MAX98357A LRC GPIO"
        range -1 48
        default -1

    config CINDER_J2_I2S_DIN
        int "MAX98357A DIN GPIO"
        range -1 48
        default -1

    config CINDER_J2_PCF_ADDR
        hex "PCF8574 address (0: find one)"
        range 0x00 0x3F
        default 0x00

    config CINDER_J2_RADAR_BIT
        int "PCF8574 pin wired to the LD2410 OUT"
        range 0 7
        default 0

    config CINDER_J2_RADAR_RX
        int "GPIO wired to the LD2410 TX for its UART reports (-1: none)"
        range -1 48
        default -1

    config CINDER_J2_PRESENCE_OFF_MS
        int "Presence hold after the radar OUT drops, ms"
        range 0 600000
        default 0

endmenu
```

## firmware/main/Kconfig.projbuild
```kconfig
menu "cinder"

config CINDER_DEV_INPUT
    bool "USB dev op: inject knob input (CINDER1 {\"op\":\"input\"})"
    default y
    help
        Lets firmware/tools/input.py send a turn, push, long push, touch or page step
        over USB, as if from the hardware (testing the now-playing controls without a hand
        on the knob). Needs physical USB, like set_ember and reset. Off: the op answers
        unknown_op.

config CINDER_DEV_SEED
    bool "Seed NVS from the build config (opt-in dev builds only)"
    default n
    help
        When NVS namespace "cinder" is empty (first boot, factory reset) or has no Wi-Fi
        SSID, write the Wi-Fi network and the Ember URL below to it (config_store.c). Off
        (the default for every build): none of these values is compiled in, and a fresh
        knob boots to the setup face for Improv USB provisioning and pairing from the app.
        Never seeds a token: the knob only uses a device token from pairing.

config CINDER_WIFI_SSID
    string "Wi-Fi SSID (dev seed)"
    depends on CINDER_DEV_SEED
    default ""
    help
        2.4 GHz network. Set it in sdkconfig.secrets (git-ignored), not here.

config CINDER_WIFI_PASSWORD
    string "Wi-Fi password (dev seed)"
    depends on CINDER_DEV_SEED
    default ""

config CINDER_EMBER_URL
    string "Ember server base URL (dev seed)"
    depends on CINDER_DEV_SEED
    default ""
    help
        http://host[:port] of the Ember server, no path. lwIP cannot resolve .local
        names, so use a LAN IP.

config CINDER_EMBER_POLL_MS
    int "Ember poll interval (ms)"
    default 2000
    help
        Default for the knob setting poll_ms (1000-10000) until Ember sends the knob's
        settings in a checkin.

config CINDER_OTA_TEST
    bool "OTA rollback test build (never for release)"
    default n
    help
        Test images for the OTA rollback paths (docs/features.md, OTA): the no-checkin
        rollback timer is 2 min instead of 30, CINDER1 {"op":"ota_fault"} arms a net or
        sha fault for the next download, and CINDER_OTA_TEST_FAULT applies while this
        image is pending verification.

config CINDER_OTA_TEST_FAULT
    string "Fault: crash_boot, no_checkin, no_render or lvgl_stall"
    depends on CINDER_OTA_TEST
    default ""
    help
        crash_boot: abort 20 s after boot. no_checkin: never check in, so the rollback
        timer fires. no_render: 10 s after boot freeze the screen and stop the LVGL
        frame callback, so the health gate rolls back with health_render (about 2 min;
        62 min while a Pomodoro runs). Only while the running image is pending
        verification, so the same image never breaks a knob that already accepted it.
        lvgl_stall: the opposite window, for the LVGL stall watchdog (off while pending):
        once the image is valid, frame_cb freezes as in no_render, so the watchdog aborts
        60-90 s later; not on the boot after that abort, which reports lvgl_stall. Every
        other boot stalls again until the image is replaced.

endmenu
```
